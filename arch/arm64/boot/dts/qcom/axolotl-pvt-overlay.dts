// SPDX-License-Identifier: GPL-2.0-only
/*
 * Copyright (c) 2020-2023, SHIFT GmbH. All rights reserved.
 */

/dts-v1/;
/plugin/;

#include <dt-bindings/clock/qcom,gcc-sdm845.h>
#include <dt-bindings/clock/qcom,camcc-sdm845.h>
#include <dt-bindings/clock/qcom,dispcc-sdm845.h>
#include <dt-bindings/clock/qcom,rpmh.h>
#include <dt-bindings/interrupt-controller/arm-gic.h>

#include "sdm845-sde-display.dtsi"
#include "sdm845-qrd.dtsi"
#include "sdm845-qrd-audio-overlay.dtsi"

#include "axolotl.dtsi"

/ {
	model = "SHIFT SHIFT6mq";
	compatible = "shift,axolotl", "qcom,sdm845-qrd", "qcom,sdm845", "qcom,qrd";
	qcom,msm-id = <321 0x20001>;
	qcom,board-id = <11 0>;
};
